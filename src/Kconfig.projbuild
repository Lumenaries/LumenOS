## src/Kconfig.projbuild
```kconfig
menu "Lumen"
    menu "Website"
        config WEB_MOUNT_POINT
            string "Website Mount Point in the VFS"
            default "/www"
            help
                Specify the mount point in the VFS.

    endmenu

    menu "Hardware"
        menu "Display"
            config HARDWARE_DISPLAY_PANEL_ROWS
                int "Display Panel Rows"
                default 4
                help
                    The number of panel rows in the display.

            config HARDWARE_DISPLAY_PANEL_COLUMNS
                int "Display Panel Columns"
                default 3
                help
                    The number of panel columns in the display.

            config HARDWARE_DISPLAY_PANEL_RES_X
                int "Display Panel X Resolution"
                default 32
                help
                    The horizontal length of each panel in the display.

            config HARDWARE_DISPLAY_PANEL_RES_Y
                int "Display Panel Y Resolution"
                default 16
                help
                    The vertical width of each panel in the display.

            config HARDWARE_DISPLAY_R1_PIN
                int "Display R1 Pin"
                default 16
                help
                    Specify the GPIO number connected to the R1 pin of the display.

            config HARDWARE_DISPLAY_G1_PIN
                int "Display G1 Pin"
                default 17
                help
                    Specify the GPIO number connected to the G1 pin of the display.

            config HARDWARE_DISPLAY_B1_PIN
                int "Display B1 Pin"
                default 18
                help
                    Specify the GPIO number connected to the B1 pin of the display.

            config HARDWARE_DISPLAY_R2_PIN
                int "Display R2 Pin"
                default 8
                help
                    Specify the GPIO number connected to the R2 pin of the display.

            config HARDWARE_DISPLAY_G2_PIN
                int "Display G2 Pin"
                default 42
                help
                    Specify the GPIO number connected to the G2 pin of the display.

            config HARDWARE_DISPLAY_B2_PIN
                int "Display B2 Pin"
                default 37
                help
                    Specify the GPIO number connected to the B2 pin of the display.

            config HARDWARE_DISPLAY_A_PIN
                int "Display A Pin"
                default 5
                help
                    Specify the GPIO number connected to the A pin of the display.

            config HARDWARE_DISPLAY_B_PIN
                int "Display B Pin"
                default 6
                help
                    Specify the GPIO number connected to the B pin of the display.

            config HARDWARE_DISPLAY_C_PIN
                int "Display C Pin"
                default 7
                help
                    Specify the GPIO number connected to the C pin of the display.

            config HARDWARE_DISPLAY_D_PIN
                int "Display D Pin"
                default 15
                help
                    Specify the GPIO number connected to the D pin of the display.

            config HARDWARE_DISPLAY_E_PIN
                int "Display E Pin"
                default -1
                help
                    Specify the GPIO number connected to the E pin of the display. -1 Disables this pin.

            config HARDWARE_DISPLAY_LAT_PIN
                int "Display LAT/STB Pin"
                default 4
                help
                    Specify the GPIO number connected to the latch/strobe pin of the display. -1 Disables this pin.

            config HARDWARE_DISPLAY_OE_PIN
                int "Display OE Pin"
                default 39
                help
                    Specify the GPIO number connected to the output-enable pin of the display. -1 Disables this pin.

            config HARDWARE_DISPLAY_CLK_PIN
                int "Display CLK Pin"
                default 9
                help
                    Specify the GPIO number connected to the clock pin of the display. -1 Disables this pin.
        endmenu

        menu "Power Button"
            config HARDWARE_POWER_BUTTON_PIN
                int "Power Button GPIO Pin"
                default 21
                help
                    Set the GPIO number of the power button pin.

            config HARDWARE_POWER_BUTTON_ACTIVE_LEVEL
                int "Power Button GPIO Pin Active Level"
                default 1
                range 0 1
                help
                    Set the active level (high or low) of the GPIO pin.

            config HARDWARE_POWER_BUTTON_RED_PIN
                int "Power Button Red LED Pin"
                default 36
                help
                    Set the GPIO number of the power button's red LED pin.

            config HARDWARE_POWER_BUTTON_GREEN_PIN
                int "Power Button Green LED Pin"
                default 38
                help
                    Set the GPIO number of the power button's green LED pin.

        endmenu

        menu "Timer Button"
            config HARDWARE_TIMER_BUTTON_PIN
                int "Timer Button GPIO Pin"
                default 13
                help
                    Set the GPIO number of the timer button pin.

            config HARDWARE_TIMER_BUTTON_ACTIVE_LEVEL
                int "Timer Button GPIO Pin Active Level"
                default 1
                range 0 1
                help
                    Set the active level (high or low) of the GPIO pin.

            config HARDWARE_TIMER_BUTTON_WHITE_PIN
                int "Timer Button White LED Pin"
                default 35
                help
                    Set the GPIO number of the timer button's white LED pin.

        endmenu

        menu "Rocker Switch One"
            config HARDWARE_ROCKER_SWITCH_ONE_UP
                int "Rocker One Up Switch"
                default 14
                help
                    Set the GPIO number of the rocker switch one's up switch pin.

            config HARDWARE_ROCKER_SWITCH_ONE_UP_ACTIVE_LEVEL
                int "Rocker One Up Switch Active Level"
                default 1
                range 0 1
                help
                    Set the active level (high or low) of the up switch pin.

            config HARDWARE_ROCKER_SWITCH_ONE_DOWN
                int "Rocker One Down Switch"
                default 12
                help
                    Set the GPIO number of the rocker switch one's down switch pin.

            config HARDWARE_ROCKER_SWITCH_ONE_DOWN_ACTIVE_LEVEL
                int "Rocker One Down Switch Active Level"
                default 1
                range 0 1
                help
                    Set the active level (high or low) of the down switch pin.

        endmenu

        menu "Rocker Switch Two"
            config HARDWARE_ROCKER_SWITCH_TWO_UP
                int "Rocker Two Up Switch"
                default 11
                help
                    Set the GPIO number of the rocker switch two's up switch pin.

            config HARDWARE_ROCKER_SWITCH_TWO_UP_ACTIVE_LEVEL
                int "Rocker Two Up Switch Active Level"
                default 1
                range 0 1
                help
                    Set the active level (high or low) of the up switch pin.

            config HARDWARE_ROCKER_SWITCH_TWO_DOWN
                int "Rocker Two Down Switch"
                default 10
                help
                    Set the GPIO number of the rocker switch two's down switch pin.

            config HARDWARE_ROCKER_SWITCH_TWO_DOWN_ACTIVE_LEVEL
                int "Rocker Two Down Switch Active Level"
                default 1
                range 0 1
                help
                    Set the active level (high or low) of the down switch pin.

        endmenu

        menu "SD Card"
            config HARDWARE_SD_CARD_CLK_PIN
                int "SD Card SPI Clock Pin"
                default 48
                help
                    Set the GPIO number of the SD card's clock pin.

            config HARDWARE_SD_CARD_MISO_PIN
                int "SD Card SPI Serial Out Pin"
                default 47
                help
                    Set the GPIO number of the SD card's serial out pin for data sent from the SD card.

            config HARDWARE_SD_CARD_MOSI_PIN
                int "SD Card SPI Serial In Pin"
                default 2
                help
                    Set the GPIO number of the SD card's serial out pin for data sent to the SD card.

            config HARDWARE_SD_CARD_CS_PIN
                int "SD Card SPI Chip Select Pin"
                default 41
                help
                    Set the GPIO number of the SD card's chip select pin.

        endmenu
    endmenu

    menu "Networking"
        menu "Wi-Fi"
            config NET_WIFI_SSID
                string "SoftAP SSID"
                default "lumen"
                help
                    SSID (network name) to setup the softAP with.

            config NET_WIFI_PASSWORD
                string "SoftAP Password"
                default "LUMENARIES"
                help
                    Wi-Fi password (WPA or WPA2) to use for the softAP.

            config NET_WIFI_PASSWORD_LENGTH
                int "Length of SoftAP Password"
                default 8
                range 8 64
                help
                    Wi-Fi password length to use for random password generation.

            config NET_WIFI_MAX_STA_CONNECTION
                int "Maxmium STA Connections"
                default 4
                help
                    Max number of STA connections to AP.
        endmenu

        menu "mDNS"
            config NET_MDNS_HOSTNAME
                string "mDNS Hostname"
                default "lumen"
                help
                    mDNS hostname to allow users users to navigate to the UI.

        endmenu
    endmenu
endmenu
```
